## Kconfig
```kconfig
menu "numDL"

config USING_NUMDL
    bool "Enable numDL"
    select NUMDL_CANDY
    default n

if USING_NUMDL

source "$OS_ROOT/thirdparty/numDL/numdl/Kconfig"

source "$OS_ROOT/thirdparty/numDL/feature/Kconfig"

source "$OS_ROOT/thirdparty/numDL/library/Kconfig"

source "$OS_ROOT/thirdparty/numDL/test/Kconfig"

endif
endmenu
```

## common/Kconfig
```kconfig
config NUMDL_USING_UTILS
    bool
    default n

config NUMDL_USING_MATRIX
    bool
    default n
```

## feature/Kconfig
```kconfig
menu "Feature"

config NUMDL_FEATURE
    bool "Enable numDL Feature Functions"
    select NUMDL_USING_KISSFFT
    default n

endmenu
```

## library/CMSIS/Kconfig
```kconfig
config UAI_CMSIS_USING_CORE
    bool "Enable CMSIS Core API"
    default n

config UAI_CMSIS_USING_DSP
    bool "Enable CMSIS DSP Software Library"
    default n

if UAI_CMSIS_USING_DSP
    menu "CMSIS DSP Software Library"

        config UAI_CMSIS_DSP_ARM_FLOAT16_SUPPORTED
            bool
            default n

        config UAI_CMSIS_DSP_USING_BASIC_MATH
            bool "Enable CMSIS DSP Basic Math Functions"
            default n

        config UAI_CMSIS_DSP_USING_BAYES
            bool "Enable CMSIS DSP Bayes Functions"
            default n

        config UAI_CMSIS_DSP_USING_COMMON_TABLES
            bool "Enable CMSIS DSP Common Tables"
            default n

        if UAI_CMSIS_DSP_USING_COMMON_TABLES

            config UAI_CMSIS_DSP_CONFIG_TABLES
            bool "Enable Configuration of Table"
            default n

            if UAI_CMSIS_DSP_CONFIG_TABLES
                source "$SDK_ROOT/sdk/library/CMSIS/ConfigTable.Kconfig"
            endif

        endif

        config UAI_CMSIS_DSP_USING_COMPLEX_MATH
            bool "Enable CMSIS DSP Complex Math Functions"
            select UAI_CMSIS_DSP_USING_FAST_MATH
            default n

        config UAI_CMSIS_DSP_USING_CONTROLLER
            bool "Enable CMSIS DSP Controller Functions"
            default n
            select UAI_CMSIS_DSP_USING_COMMON_TABLES

        config UAI_CMSIS_DSP_USING_DISTANCE
            bool "Enable CMSIS DSP Distance Functions"
            default n
            select UAI_CMSIS_DSP_USING_COMMON_TABLES

        config UAI_CMSIS_DSP_USING_FAST_MATH
            bool "Enable CMSIS DSP Fast Math Functions"
            default n
            select UAI_CMSIS_DSP_USING_COMMON_TABLES

        config UAI_CMSIS_DSP_USING_FILTERING
            bool "Enable CMSIS DSP Filtering Functions"
            default n
            select UAI_CMSIS_DSP_USING_COMMON_TABLES

        config UAI_CMSIS_DSP_USING_INTERPOLATION
            bool "Enable CMSIS DSP Interpolation Functions"
            default n

        config UAI_CMSIS_DSP_USING_MATRIX
            bool "Enable CMSIS DSP Matrix Functions"
            default n

        config UAI_CMSIS_DSP_USING_QUATERNION_MATH
            bool "Enable CMSIS DSP Quaternion MATH Functions"
            default n

        config UAI_CMSIS_DSP_USING_STATISTICS
            bool "Enable CMSIS DSP Statistics Functions"
            select UAI_CMSIS_DSP_USING_BASIC_MATH
            select UAI_CMSIS_DSP_USING_FAST_MATH
            default n

        config UAI_CMSIS_DSP_USING_SUPPORT
            bool "Enable CMSIS DSP Support Functions"
            default n

        config UAI_CMSIS_DSP_USING_SVM
            bool "Enable CMSIS DSP SVM Functions"
            default n
            select UAI_CMSIS_DSP_USING_COMMON_TABLES

        config UAI_CMSIS_DSP_USING_TRANSFORM
            bool "Enable CMSIS DSP Transform Functions"
            default n
            select UAI_CMSIS_DSP_USING_BASIC_MATH
            select UAI_CMSIS_DSP_USING_COMMON_TABLES
            select UAI_CMSIS_DSP_USING_COMPLEX_MATH

    endmenu

endif

config UAI_CMSIS_USING_NN
    bool "Enable CMSIS Neural Network Kernels"
    default n
    select UAI_CMSIS_USING_CORE
```

## library/Kconfig
```kconfig
menu "Library"

config NUMDL_USING_CMSIS
    bool "Enable CMSIS Software Library" 
    default n

config NUMDL_USING_KISSFFT
    bool "Enable Kissfft Software Library"
    default n

if NUMDL_USING_CMSIS
    source "$OS_ROOT/thirdparty/numDL/library/CMSIS/Kconfig"
endif

endmenu
```

## numdl/Kconfig
```kconfig
menu "Candy"

config NUMDL_CANDY
    bool "Enable numDL Magic Candy"
    default n

if NUMDL_CANDY

    config NUMDL_USING_ASSERT
        bool "Enable numDL assert check"
        default n

    choice
        prompt "numDL log level"
        default NUMDL_LOG_LVL_6

        config NUMDL_LOG_LVL_3
            bool "error"

        config NUMDL_LOG_LVL_4
            bool "warning"

        config NUMDL_LOG_LVL_6
            bool "information"

        config NUMDL_LOG_LVL_7
            bool "debug"
    endchoice
    config NUMDL_LOG_LVL
        int
        default 3  if NUMDL_LOG_LVL_3
        default 4  if NUMDL_LOG_LVL_4
        default 6 if NUMDL_LOG_LVL_6
        default 7 if NUMDL_LOG_LVL_7



endif
endmenu
```

## test/Kconfig
```kconfig
menu "Test"

config NUMDL_USING_TEST
    bool "Enable Test Cases" 
    default n
    select OS_USING_ATEST

if NUMDL_USING_TEST
    config NUMDL_TEST_USING_MATRIX_TC
        bool "Enable numDL Matrix Functions Test"
        default n
        select NUMDL_USING_MATRIX

    config NUMDL_TEST_USING_FEATURE_TC
        bool "Enable numDL Feature Functions Test"
        default n
        select NUMDL_FEATURE
endif

endmenu
```
